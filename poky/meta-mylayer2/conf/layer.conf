## poky/meta-mylayer2/conf/layer.conf
```bitbake
# We have a conf and classes directory, add to BBPATH
BBPATH .= ":${LAYERDIR}"

# We have recipes-* directories, add to BBFILES
BBFILES += "${LAYERDIR}/recipes-*/*/*.bb \
            ${LAYERDIR}/recipes-*/*/*.bbappend"

BBFILE_COLLECTIONS += "meta-mylayer2"
BBFILE_PATTERN_meta-mylayer2 = "^${LAYERDIR}/"
BBFILE_PRIORITY_meta-mylayer2 = "6"

LAYERDEPENDS_meta-mylayer2 = "core"
LAYERSERIES_COMPAT_meta-mylayer2 = "kirkstone"
```
